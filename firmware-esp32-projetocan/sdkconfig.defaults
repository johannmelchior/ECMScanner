## firmware-esp32-projetocan/sdkconfig.defaults
```kconfig
# Custom UART Console Settings
CONFIG_ESP_CONSOLE_UART_DEFAULT=n
CONFIG_ESP_CONSOLE_UART_CUSTOM=y
CONFIG_ESP_CONSOLE_UART_BAUDRATE=500000
```
